## CMakeLists.txt
```
# SPDX-License-Identifier: Apache-2.0

cmake_minimum_required(VERSION 3.13.1)

set(BOARD nrf5340dk_nrf5340_cpuapp)

find_package(Zephyr REQUIRED HINTS $ENV{ZEPHYR_BASE})
project(threads)

# target_sources(app PRIVATE
#     src/main.c
#     src/audio_soundboard_functions.c
#     src/minmea.c
#     )

FILE(GLOB app_sources src/*.c)
target_sources(app PRIVATE ${app_sources})
```

## prj.conf
```kconfig
#CONFIGURATION OPTIONS
#https://docs.zephyrproject.org/latest/reference/kconfig/index-all.html

#Send printk() to console
CONFIG_PRINTK=y
#Size of stack for initialization and main thread
CONFIG_MAIN_STACK_SIZE=1024
#System workqueue stack size
CONFIG_SYSTEM_WORKQUEUE_STACK_SIZE=4096
#System workqueue stack size
CONFIG_HEAP_MEM_POOL_SIZE=256
#Enable __ASSERT() macro
CONFIG_ASSERT=y
# Enable GPIO Support (Drivers)
CONFIG_GPIO=y
# Enable UART Support (Drivers)
CONFIG_SERIAL=y
# Enable new asynchronous UART API
CONFIG_UART_ASYNC_API=y
# Enable Enable floating point unit (FPU)
CONFIG_FPU=y
# Enable I2C Support (Drivers)
CONFIG_I2C=y
#CONFIG_I2C_0=y
# CONFIG_I2C_NRFX=y
#CONFIG_NEWLIB_LIBC=y
```

## nrf5340dk_nrf5340_cpuapp.overlay
```dts
//pin_no = b*32 + a
//P1.1 = (1*32) + 1 = 33

&i2c1 {
  status = "disabled";
};
//GPS
&uart1 {
  compatible = "nordic,nrf-uarte";
  current-speed = <9600>;
  status = "okay";
  rts-pin = <11>;//SB28
  tx-pin = <33>;//P1.01 - SB30
  rx-pin = <32>;//P1.00 - SB29
};
//AUDIO FX
&uart2 {
  compatible = "nordic,nrf-uarte";
  current-speed = <9600>;
  status = "okay";
  //rts-pin = <19>;//P0.19 - SB51
  tx-pin = <40>;//P1.08 - SB53
  rx-pin = <41>;//P1.09 - SB53
};
//UV
&i2c3 {
  #address-cells = <1>;
  #size-cells = <0>;
  reg = <0xc000 0x1000>;
  clock-frequency = <100000>;
  interrupts = <12 1>;
  status = "okay";
  label = "I2C_3";
  compatible = "nordic,nrf-twim";
  sda-pin = < 34 >;//P1.02 - SDA
  scl-pin = < 35 >;//P1.03 - SCL
 };
//Debug UART
// &uart0 {
  //   status = "okay";
  //   current-speed = <115200>;
  //   tx-pin = <20>;
  //   rx-pin = <22>;
  //   rts-pin = <19>;
  //   cts-pin = <21>;
// };
//I2C
// i2c1: i2c@9000 {
//   #address-cells = < 0x1 >;
//   #size-cells = < 0x0 >;
//   reg = < 0x9000 0x1000 >;
//   clock-frequency = < 0x186a0 >;
//   interrupts = < 0x9 0x1 >;
//   status = "disabled";
//   label = "I2C_1";
//   compatible = "nordic,nrf-twim";
//   sda-pin = < 0x22 >;
//   scl-pin = < 0x23 >;
// };
// i2c2: i2c@b000 {
//   #address-cells = <1>;
//   #size-cells = <0>;
//   reg = <0xb000 0x1000>;
//   clock-frequency = <100000>;
//   interrupts = <11 1>;
//   status = "disabled";
//   label = "I2C_2";
//  };
```

## src/main.c
```c
#include <zephyr.h>
#include <device.h>
#include <drivers/gpio.h>
#include <sys/util.h>
#include <sys/printk.h>
#include <inttypes.h>
#include <string.h>
#include <drivers/i2c.h> /*I2C*/
#include <drivers/uart.h>/*UART*/
#include "config.h"
#include "uv_config.h"
#include "audio_soundboard.h"
#include "minmea.h"
// #include <time.h>

//Statically define and initialize a semaphore.
K_SEM_DEFINE(tx_done, 0, 1);
K_SEM_DEFINE(tx_aborted, 0, 1);
K_SEM_DEFINE(rx_rdy, 0, 1);
K_SEM_DEFINE(rx_buf_released, 0, 1);
K_SEM_DEFINE(rx_disabled, 0, 1);

// atically define and initialize a FIFO queue.
K_FIFO_DEFINE(audio_fifo);

volatile size_t read_len;

volatile uint8_t rx_buf[300] = { 0 };

volatile size_t sent;
volatile size_t received;
volatile bool failed_in_isr;

volatile uint8_t seconds;
volatile uint8_t minutes;
volatile uint8_t hours;
volatile float speed;
volatile uint8_t uv;
volatile uint8_t uv_index = 0;
volatile uint8_t kph = 0;

volatile uint8_t prev_uv_index = 0;
volatile uint8_t prev_kph = 0;
volatile uint8_t countdown = 0;

const struct device *uart_dev;
const struct device *uart_audio_dev;
const struct device *i2c_dev;
const struct device *button;
const struct device *speed_button;
const struct device *uv_button;

// Structs
struct audio_data_t {
	void *fifo_reserved; /* 1st word reserved for use by fifo */
	uint16_t timer;
	char txt[13];
};

struct rx_source {
	int cnt;
	uint8_t prev;
};

const struct uart_config uart_cfg = { .baudrate = 9600,
				      .parity = UART_CFG_PARITY_NONE,
				      .stop_bits = UART_CFG_STOP_BITS_1,
				      .data_bits = UART_CFG_DATA_BITS_8,
				      .flow_ctrl = UART_CFG_FLOW_CTRL_NONE };

// function declaration
void insertQueueAudio(struct audio_data_t *tx_data);
static struct gpio_callback button_cb_data;
static struct gpio_callback speed_button_cb_data;
static struct gpio_callback uv_button_cb_data;

void insertQueueAudio(struct audio_data_t *tx_data)//Insert into FIFO queue
{
	size_t size = sizeof(struct audio_data_t);
	char *mem_ptr = k_malloc(size);//Allocate memory from the heap.
	__ASSERT_NO_MSG(mem_ptr != 0);
	memcpy(mem_ptr, tx_data, size);
	k_fifo_put(&audio_fifo, mem_ptr);//Add an element to a FIFO queue.
}

void createString(uint8_t a)//Create string command for Audio FX Track
{
	char str[2];
	char phrase[13] = "P        OGG\n";
	sprintf(str, "%d", a);
	uint8_t i;
	uint8_t len = strlen(str);
	//printk("LEN %d -%s-\n", len, str);
	for (i = 0; i < len; ++i) {
		phrase[i + 1] = str[i];
	}
	// printk("-%s-\n", phrase);
	struct audio_data_t tx_data1 = { .timer = a < 11 && a > 19 ? 1000 : 1100 };//Give for time for teens eg fourteen
	strcpy(tx_data1.txt, phrase);
	insertQueueAudio(&tx_data1);
}
void uv_pressed()
{//UV Button Pressed Callback
	struct audio_data_t tx_uv = { .timer = 2000, .txt = "PUV      OGG\n" };
	insertQueueAudio(&tx_uv);
	//Get UV index
	//https://en.wikipedia.org/wiki/Ultraviolet_index#Index_usage
	switch (uv_index) {
	case 0:;
		struct audio_data_t tx_none = { .timer = 1000,
						.txt = "PNONE    OGG\n" };
		insertQueueAudio(&tx_none);
		break;
	case 1:;
	case 2:;
		struct audio_data_t tx_low = { .timer = 1000,
					       .txt = "PLOW     OGG\n" };
		insertQueueAudio(&tx_low);
		break;
	case 3:;
	case 4:;
	case 5:;
		struct audio_data_t tx_moderate = { .timer = 1000,
						    .txt = "PMODERATEOGG\n" };
		insertQueueAudio(&tx_moderate);
		break;
	case 6:;
	case 7:;
		struct audio_data_t tx_high = { .timer = 1000,
						.txt = "PHIGH    OGG\n" };
		insertQueueAudio(&tx_high);
		break;
	case 8:;
	case 9:;
	case 10:;
		struct audio_data_t tx_vhigh = { .timer = 1000,
						 .txt = "PVHIGH    OGG\n" };
		insertQueueAudio(&tx_vhigh);
		break;
	default:;
		struct audio_data_t tx_extreme = { .timer = 1000,
						   .txt = "PEXTREME OGG\n" };
		insertQueueAudio(&tx_extreme);
	}
}
void speed_pressed()//const struct device *dev, struct gpio_callback *cb, uint32_t pins
{//Speed Button Pressed Callback
	// printk("SPEED %.2f, %d\n", speed, kph);
	// struct audio_data_t tx_speed = { .timer = 1200,
	// 				 .txt = "PSPEED   OGG\n" };
	// insertQueueAudio(&tx_speed);
	createString(kph);
	struct audio_data_t tx_kph = { .timer = 1400, .txt = "PKPH     OGG\n" };
	insertQueueAudio(&tx_kph);
}
void button_pressed(const struct device *dev, struct gpio_callback *cb,
		    uint32_t pins)
{//Time Buton Pressed Callback
	uint8_t rem = minutes % 10;
	uint8_t csth = (hours < 5) ? (19 + hours) : (hours - 5);//CST
	uint8_t remh = csth % 10;
	printk("%d:%d:%d\n", hours, minutes, seconds);
	printk("%d:%d:%d\n", csth, minutes, seconds);

	if (remh > 0 && csth > 19) {
		createString(csth - remh);
		createString(remh);
	} else {
		createString(csth);
	}

	struct audio_data_t tx_dataHours = { .timer = 800,
					     .txt = "PHOURS   OGG\n" };
	insertQueueAudio(&tx_dataHours);
	if (rem > 0 && minutes > 19) {
		createString(minutes - rem);
		createString(rem);
	} else {
		createString(minutes);
	}
	struct audio_data_t tx_dataMinutes = { .timer = 700,
					       .txt = "PMINUTES OGG\n" };
	insertQueueAudio(&tx_dataMinutes);
}
bool StartsWith(const char *a, const char *b)//Get if string starts with other string usefull for checinkg prefix
{
	if (strncmp(a, b, strlen(b)) == 0)
		return 1;
	return 0;
}
void parseNamea()
{
	char *rest = rx_buf;
	char *nmea;
	// GPGGA - Global Positioning System Fix Data
	// GPGSA - GPS DOP and active satellites
	// GPRMC - Recommended minimum specific GPS/Transit data
	// GPGSV - GPS Satellites in view
	// GPVTG - Track made good and ground speed
	// http://aprs.gids.nl/nmea/

	while ((nmea = strtok_r(rest, "\r\n", &rest))) {
		switch (minmea_sentence_id(nmea, false)) {
		// $GPGGA,hhmmss.ss,llll.ll,a,yyyyy.yy,a,x,xx,x.x,x.x,M,x.x,M,x.x,xxxx*hh
		// 1    = UTC of Position
		// 2    = Latitude
		// 3    = N or S
		// 4    = Longitude
		// 5    = E or W
		// 6    = GPS quality indicator (0=invalid; 1=GPS fix; 2=Diff. GPS fix)
		// 7    = Number of satellites in use [not those in view]
		// 8    = Horizontal dilution of position
		// 9    = Antenna altitude above/below mean sea level (geoid)
		// 10   = Meters  (Antenna height unit)
		// 11   = Geoidal separation (Diff. between WGS-84 earth ellipsoid and
		//        mean sea level.  -=geoid is below WGS-84 ellipsoid)
		// 12   = Meters  (Units of geoidal separation)
		// 13   = Age in seconds since last update from diff. reference station
		// 14   = Diff. reference station ID#
		// 15   = Checksum
		case MINMEA_SENTENCE_GGA: {
			// printk("%s\n", nmea);
			struct minmea_sentence_gga frame;
			if (minmea_parse_gga(&frame, nmea)) {
				seconds = frame.time.seconds;
				minutes = frame.time.minutes;
				hours = frame.time.hours;

				// printk("$xxGGA: fix quality: %d\n",
				//        frame.fix_quality);
				// printk("SATELITES %d \n",
				//        frame.satellites_tracked);
				// printf("ALTITUD3 %.2f \n",
				//        minmea_tofloat(&frame.altitude));
				// printk("SEC %d \n", frame.time.seconds);

			} else {
				printk("$xxGGA sentence is not parsed\n");
			}
		} break;
		// $GPVTG,t,T,,,s.ss,N,s.ss,K*hh
		// 1    = Track made good
		// 2    = Fixed text 'T' indicates that track made good is relative to true north
		// 3    = not used
		// 4    = not used
		// 5    = Speed over ground in knots
		// 6    = Fixed text 'N' indicates that speed over ground in in knots
		// 7    = Speed over ground in kilometers/hour
		// 8    = Fixed text 'K' indicates that speed over ground is in kilometers/hour
		// 9    = Checksum
		case MINMEA_SENTENCE_VTG: {
			// printk("%s\n", nmea);
			struct minmea_sentence_vtg frame;
			if (minmea_parse_vtg(&frame, nmea)) {
				speed = minmea_tofloat(&frame.speed_kph);
				kph = speed;
				// printf("SPEED %.2f \n",
				//        minmea_tofloat(&frame.speed_kph));
				// struct minmea_float true_track_degrees;
				// struct minmea_float magnetic_track_degrees;
				// struct minmea_float speed_knots;
				// struct minmea_float speed_kph;
				// enum minmea_faa_mode faa_mode;

			} else {
				printk("$xxGGA sentence is not parsed\n");
			}
		} break;
		}
	}
}

void uart_read_callback(const struct device *uart_dev, struct uart_event *evt,
			void *user_data)
{
	// List of Events
	//https://docs.zephyrproject.org/latest/reference/peripherals/uart.html?highlight=uart_rx_rdy#c.uart_event_type.UART_TX_DONE
	switch (evt->type) {
	case UART_TX_DONE://Whole TX buffer was transmitted.
		k_sem_give(&tx_done);
		break;
	case UART_RX_RDY://Received data is ready for processing.
		read_len = evt->data.rx.len;
		k_sem_give(&rx_rdy);
		//printk("%s\n", rx_buf);
		// printk("LEN %d\n", evt->data.rx.len);
		// printk("Event %d\n", evt->type);
		parseNamea();
		int ret4 = uart_rx_enable(uart_dev, rx_buf, 300, 50);//Start receiving data through UART. // intuart_rx_enable(conststructdevice*dev, uint8_t*buf, size_tlen, int32_ttimeout)
		if (ret4 != 0) {
			printk("uart_rx_enable Error %d\n", ret4);
			return;
		}
		break;
	case UART_RX_DISABLED://RX has been disabled and can be reenabled.
		k_sem_give(&rx_disabled);
		break;
	default:
		break;
	}
}
uint16_t read16(const struct device *i2c_dev, uint16_t addr)
{
	uint8_t cmp_data[16];
	uint8_t data[16];
	int ret;
	data[0] = 0x00;
	cmp_data[0] = addr;
	ret = i2c_write_read(i2c_dev, 0x60, &cmp_data[0], 1, &data[0], 2);
	if (ret) {
		printk("Error writing to FRAM! error code (%d)\n", ret);
	}
	return data[0] | data[1] << 8;
}
void write8(const struct device *i2c_dev, uint16_t addr, uint16_t data)
{
	int ret;
	uint8_t cmp_data[16];
	cmp_data[0] = addr;
	cmp_data[1] = data;
	ret = i2c_write(i2c_dev, &cmp_data, 2, SI1145_ADDR);
	if (ret) {
		printk("Error writing code (%d)\n", ret);
		return;
	}
}
static int write_bytes(const struct device *i2c_dev, uint16_t addr,
		       uint8_t *data, uint32_t num_bytes)
{
	uint8_t wr_addr[2];
	struct i2c_msg msgs[2];

	/* FRAM address */
	wr_addr[0] = (addr >> 8) & 0xFF;
	wr_addr[1] = addr & 0xFF;

	/* Setup I2C messages */

	/* Send the address to write to */
	msgs[0].buf = wr_addr;
	msgs[0].len = 2U;
	msgs[0].flags = I2C_MSG_WRITE;

	/* Data to be written, and STOP after this. */
	msgs[1].buf = data;
	msgs[1].len = num_bytes;
	msgs[1].flags = I2C_MSG_WRITE | I2C_MSG_STOP;

	return i2c_transfer(i2c_dev, &msgs[0], 2, SI1145_ADDR);
}
static int read_bytes(const struct device *i2c_dev, uint16_t addr,
		      uint8_t *data, uint32_t num_bytes)
{
	uint8_t wr_addr[2];
	struct i2c_msg msgs[2];

	/* Now try to read back from FRAM */

	/* FRAM address */
	wr_addr[0] = (addr >> 8) & 0xFF;
	wr_addr[1] = addr & 0xFF;

	/* Setup I2C messages */

	/* Send the address to read from */
	msgs[0].buf = wr_addr;
	msgs[0].len = 2U;
	msgs[0].flags = I2C_MSG_WRITE;

	/* Read from device. STOP after this. */
	msgs[1].buf = data;
	msgs[1].len = num_bytes;
	msgs[1].flags = I2C_MSG_READ | I2C_MSG_STOP;

	return i2c_transfer(i2c_dev, &msgs[0], 2, SI1145_ADDR);
}
uint8_t writeParam(const struct device *i2c_dev, uint8_t p, uint8_t v)
{
	write8(i2c_dev, SI1145_REG_PARAMWR, v);
	write8(i2c_dev, SI1145_REG_COMMAND, p | SI1145_PARAM_SET);
	//   return read_bytes(i2c_dev, SI1145_REG_PARAMRD, 1);

	int i, ret;
	uint8_t data[16];
	data[0] = 0x00;
	ret = read_bytes(i2c_dev, SI1145_REG_PARAMRD, &data[0], 1);
	if (ret) {
		printk("Error reading from FRAM! error code (%d)\n", ret);
		return;
	}
	return data[0];
}
void reset(const struct device *i2c_dev)
{
	write8(i2c_dev, SI1145_REG_MEASRATE0, 0);
	write8(i2c_dev, SI1145_REG_MEASRATE1, 0);
	write8(i2c_dev, SI1145_REG_IRQEN, 0);
	write8(i2c_dev, SI1145_REG_IRQMODE1, 0);
	write8(i2c_dev, SI1145_REG_IRQMODE2, 0);
	write8(i2c_dev, SI1145_REG_INTCFG, 0);
	write8(i2c_dev, SI1145_REG_IRQSTAT, 0xFF);

	write8(i2c_dev, SI1145_REG_COMMAND, SI1145_RESET);
	k_msleep(10);
	write8(i2c_dev, SI1145_REG_HWKEY, 0x17);
	k_msleep(10);
}
void SI1145(const struct device *i2c_dev)
{
	reset(i2c_dev);
	// enable UVindex measurement coefficients!
	write8(i2c_dev, SI1145_REG_UCOEFF0, 0x29);
	write8(i2c_dev, SI1145_REG_UCOEFF1, 0x89);
	write8(i2c_dev, SI1145_REG_UCOEFF2, 0x02);
	write8(i2c_dev, SI1145_REG_UCOEFF3, 0x00);

	// enable UV sensor
	writeParam(i2c_dev, SI1145_PARAM_CHLIST,
		   SI1145_PARAM_CHLIST_ENUV | SI1145_PARAM_CHLIST_ENALSIR |
			   SI1145_PARAM_CHLIST_ENALSVIS |
			   SI1145_PARAM_CHLIST_ENPS1);
	// enable interrupt on every sample
	write8(i2c_dev, SI1145_REG_INTCFG, SI1145_REG_INTCFG_INTOE);
	write8(i2c_dev, SI1145_REG_IRQEN, SI1145_REG_IRQEN_ALSEVERYSAMPLE);

	// program LED current
	write8(i2c_dev, SI1145_REG_PSLED21, 0x03); // 20mA for LED 1 only
	writeParam(i2c_dev, SI1145_PARAM_PS1ADCMUX,
		   SI1145_PARAM_ADCMUX_LARGEIR);
	// prox sensor #1 uses LED #1
	writeParam(i2c_dev, SI1145_PARAM_PSLED12SEL,
		   SI1145_PARAM_PSLED12SEL_PS1LED1);
	// fastest clocks, clock div 1
	writeParam(i2c_dev, SI1145_PARAM_PSADCGAIN, 0);
	// take 511 clocks to measure
	writeParam(i2c_dev, SI1145_PARAM_PSADCOUNTER,
		   SI1145_PARAM_ADCCOUNTER_511CLK);
	// in prox mode, high range
	writeParam(i2c_dev, SI1145_PARAM_PSADCMISC,
		   SI1145_PARAM_PSADCMISC_RANGE |
			   SI1145_PARAM_PSADCMISC_PSMODE);

	writeParam(i2c_dev, SI1145_PARAM_ALSIRADCMUX,
		   SI1145_PARAM_ADCMUX_SMALLIR);
	// fastest clocks, clock div 1
	writeParam(i2c_dev, SI1145_PARAM_ALSIRADCGAIN, 0);
	// take 511 clocks to measure
	writeParam(i2c_dev, SI1145_PARAM_ALSIRADCOUNTER,
		   SI1145_PARAM_ADCCOUNTER_511CLK);
	// in high range mode
	writeParam(i2c_dev, SI1145_PARAM_ALSIRADCMISC,
		   SI1145_PARAM_ALSIRADCMISC_RANGE);

	// fastest clocks, clock div 1
	writeParam(i2c_dev, SI1145_PARAM_ALSVISADCGAIN, 0);
	// take 511 clocks to measure
	writeParam(i2c_dev, SI1145_PARAM_ALSVISADCOUNTER,
		   SI1145_PARAM_ADCCOUNTER_511CLK);
	// in high range mode (not normal signal)
	writeParam(i2c_dev, SI1145_PARAM_ALSVISADCMISC,
		   SI1145_PARAM_ALSVISADCMISC_VISRANGE);

	// measurement rate for auto
	write8(i2c_dev, SI1145_REG_MEASRATE0, 0xFF); // 255 * 31.25uS = 8ms

	// auto run
	write8(i2c_dev, SI1145_REG_COMMAND, SI1145_PSALS_AUTO);
}

void main(void)
{
	printk("Hello World!\n");
	//I2C
	i2c_dev = device_get_binding("I2C_3");
	if (i2c_dev == NULL) {
		printk("Error: I2C didn't find device\n");
		return;
	}
	uint32_t dev_config =
		I2C_SPEED_SET(I2C_SPEED_STANDARD) | I2C_MODE_MASTER;//I2C Standard Speed: 100 kHz and Controller to act as Master.
	int i2c_config = i2c_configure(i2c_dev, dev_config);//Configure operation of a host controller.
	if (i2c_config != 0) {
		printk("Error: %d\n", i2c_config);
		return;
	}
	SI1145(i2c_dev);//Init UV Sensor

	// Input Time Pin
	button = device_get_binding(SW0_GPIO_LABEL);
	if (button == NULL) {
		printk("Error: PIN0 - didn't find %s device\n", SW0_GPIO_LABEL);
		return;
	}

	int ret = gpio_pin_configure(button, SW0_GPIO_PIN, SW0_GPIO_FLAGS);
	if (ret != 0) {
		printk("Error %d: failed to configure %s pin %d\n", ret,
		       SW0_GPIO_LABEL, SW0_GPIO_PIN);
		return;
	}

	int ret2 = gpio_pin_interrupt_configure(button, SW0_GPIO_PIN,
						GPIO_INT_EDGE_TO_ACTIVE);
	if (ret2 != 0) {
		printk("gpio_pin_interrupt_configure Error %d: failed to configure interrupt on %s pin %d\n",
		       ret2, SW0_GPIO_LABEL, SW0_GPIO_PIN);
		return;
	}

	gpio_init_callback(&button_cb_data, button_pressed, BIT(SW0_GPIO_PIN));
	gpio_add_callback(button, &button_cb_data);
	printk("Set up button at %s pin %d\n", SW0_GPIO_LABEL, SW0_GPIO_PIN);

	//Speed Button
	speed_button = device_get_binding(SW1_GPIO_LABEL);
	if (speed_button == NULL) {
		printk("Error: PIN1 - didn't find %s device\n", SW1_GPIO_LABEL);
		return;
	}
	int speed_config =
		gpio_pin_configure(speed_button, SW1_GPIO_PIN, SW1_GPIO_FLAGS);
	if (speed_config != 0) {
		printk("Error %d: failed to configure %s pin %d\n",
		       speed_config, SW1_GPIO_LABEL, SW1_GPIO_PIN);
		return;
	}
	int speed_int = gpio_pin_interrupt_configure(speed_button, SW1_GPIO_PIN,
						     GPIO_INT_EDGE_TO_ACTIVE);
	if (speed_int != 0) {
		printk("gpio_pin_interrupt_configure Error %d: failed to configure interrupt on %s pin %d\n",
		       speed_int, SW1_GPIO_LABEL, SW1_GPIO_PIN);
		return;
	}
	gpio_init_callback(&speed_button_cb_data, speed_pressed,
			   BIT(SW1_GPIO_PIN));
	gpio_add_callback(speed_button, &speed_button_cb_data);
	printk("Set up button at %s pin %d\n", SW1_GPIO_LABEL, SW1_GPIO_PIN);

	//UV Button
	uv_button = device_get_binding(SW2_GPIO_LABEL);
	if (uv_button == NULL) {
		printk("Error: PIN2 - didn't find %s device\n", SW2_GPIO_LABEL);
		return;
	}
	int uv_config =
		gpio_pin_configure(uv_button, SW2_GPIO_PIN, SW2_GPIO_FLAGS);//Configure a single pin.
	if (uv_config != 0) {
		printk("Error %d: failed to configure %s pin %d\n", uv_config,
		       SW2_GPIO_LABEL, SW2_GPIO_PIN);
		return;
	}
	int uv_int = gpio_pin_interrupt_configure(uv_button, SW2_GPIO_PIN,
						  GPIO_INT_EDGE_TO_ACTIVE);//Configure pin interrupt on logical level 1 and enables it.
	if (uv_int != 0) {
		printk("gpio_pin_interrupt_configure Error %d: failed to configure interrupt on %s pin %d\n",
		       uv_int, SW2_GPIO_LABEL, SW2_GPIO_PIN);
		return;
	}
	gpio_init_callback(&uv_button_cb_data, uv_pressed, BIT(SW2_GPIO_PIN));//Helper to initialize a struct gpio_callback properly
	gpio_add_callback(uv_button, &uv_button_cb_data);//Set button callback function
	printk("Set up button at %s pin %d\n", SW2_GPIO_LABEL, SW2_GPIO_PIN);

	// UART
	uart_dev = device_get_binding(UART_LABEL);
	if (uart_dev == NULL) {
		printk("device_get_binding Error\n"); 
		return;
	}

	int ret3 = uart_configure(uart_dev, &uart_cfg);//Configure UART device
	if (ret3 != 0) {
		printk("uart_configure Error %d\n", ret3);
		return;
	}

	int ret4 = uart_rx_enable(uart_dev, rx_buf, 300, 50);//Start receiving data through UART. 
	if (ret4 != 0) {
		printk("uart_rx_enable Error %d\n", ret4);
		return;
	}

	int ret5 = uart_callback_set(uart_dev, uart_read_callback, NULL);//Create UART callback for incoming data
	if (ret5 != 0) {
		printk("uart_callback_set Error %d\n", ret5);
		return;
	}
}
void audio_fx_out(void)
{
	while (1) {
		/*Read from and delete from FIFO*/
		//https://docs.zephyrproject.org/latest/reference/kernel/data_passing/fifos.html?highlight=k_fifo_put#c.k_fifo_put_list
		struct audio_data_t *rx_data =
			k_fifo_get(&audio_fifo, K_FOREVER);//Get data from FIFO Queue
		if (rx_data != NULL) {//If queue is not empty
			const struct device *uart_dev;
			uart_dev = device_get_binding(UART_AUDIO);
			if (uart_dev == NULL) {
				printk("Error: UART AUDIO -didn't find device\n"); 
				return;
			}
			playTrack(uart_dev, rx_data->txt);//Send UART command to track
			k_msleep(rx_data->timer);//Sleep for x ms time
		}
		k_free(rx_data);
		//Free memory allocated from heap.
		//https://docs.zephyrproject.org/latest/reference/kernel/memory/heap.html?highlight=k_free#c.k_free
	}
}
//Statically define and initialize a thread.
//https://docs.zephyrproject.org/latest/reference/kernel/threads/index.html?highlight=k_thread_define#c.K_THREAD_DEFINE
K_THREAD_DEFINE(audio_fx_id, STACKSIZE, audio_fx_out, NULL, NULL, NULL,
		PRIORITY, 0, 0);//Thread for send UART commends to AUDIO FX board

void uv_out(void)
{
	uint8_t cmp_data[16];
	uint8_t data[16];
	int i, ret;
	const struct device *i2c_dev;
	i2c_dev = device_get_binding("I2C_3");
	if (i2c_dev == NULL) {
		printk("Error: I2C didn't find device\n");
		return;
	}
	while (1) {
		uv = read16(i2c_dev, 0x2C);
		uv_index = uv / 100;
		k_msleep(1000);//Sleep 1000ms or 1 sec
	}
}
K_THREAD_DEFINE(uv_id, STACKSIZE / 2, uv_out, NULL, NULL, NULL, PRIORITY, 0, 0);//Thread read UV from I2C

void get_data(void)
{
	while (1) {
		uint8_t csth = (hours < 5) ? (19 + hours) : (hours - 5);//GET CST Time
		if(uv_index != prev_uv_index){// If UV index is not the same
			prev_uv_index = uv_index;
			printk("UV Index %d\n", uv_index);
			uv_pressed();//Print current UV Index
		}
		if(kph != prev_kph && kph > 2){// If current speed is > 2 kph
			prev_kph = kph;
			printk("KPH %d\n", kph);
			speed_pressed();// say current speed
		}
		if(countdown > 180){//Wait 15 min  5000 * 180 = 900000 ms
			if(kph < 2 && csth > 8 && csth < 18){//Check if its day time, if time > 8 AM and < 6 PM (we dont want to go out at night )
				struct audio_data_t tx_dataHours = { .timer = 800,
										.txt = "PTIMEWALKOGG\n" };// Audio time to go outside
				insertQueueAudio(&tx_dataHours);
				countdown = 0;// Reset 15 min timer
			}
		}
		countdown = countdown + 1;
		k_msleep(5000);//Sleep 5000ms or 5 sec
	}
}
K_THREAD_DEFINE(data_id, STACKSIZE / 2, get_data, NULL, NULL, NULL, PRIORITY, 0, 0);//Thread for timers
```

## src/adafruit_gps.h
```c
// https://github.com/adafruit/Adafruit_GPS
#ifndef _ADAFRUIT_GPS_H
#define _ADAFRUIT_GPS_H

#include <inttypes.h>
#include <device.h>
#include <drivers/uart.h>/*UART*/

/* Parameters */
#define UART_BAUDRATE 9600
#define UART_LABEL "UART_1"
#define COMMAND_SIZE 2
#define TRACK_SIZE 13



typedef enum {
  NMEA_BAD = 0, ///< passed none of the checks
  NMEA_HAS_DOLLAR =
      1, ///< has a dollar sign or exclamation mark in the first position
  NMEA_HAS_CHECKSUM = 2,   ///< has a valid checksum at the end
  NMEA_HAS_NAME = 4,       ///< there is a token after the $ followed by a comma
  NMEA_HAS_SOURCE = 10,    ///< has a recognized source ID
  NMEA_HAS_SENTENCE = 20,  ///< has a recognized sentence ID
  NMEA_HAS_SENTENCE_P = 40 ///< has a recognized parseable sentence ID
} nmea_check_t;

class Adafruit_GPS : public Print {
public:
  // Adafruit_GPS.cpp
  bool begin(uint32_t baud_or_i2caddr);



  int thisCheck = 0; ///< the results of the check on the current sentence
  char thisSource[NMEA_MAX_SOURCE_ID] = {
      0}; ///< the first two letters of the current sentence, e.g. WI, GP
  char thisSentence[NMEA_MAX_SENTENCE_ID] = {
      0}; ///< the next three letters of the current sentence, e.g. GLL, RMC
  char lastSource[NMEA_MAX_SOURCE_ID] = {
      0}; ///< the results of the check on the most recent successfully parsed
          ///< sentence
  char lastSentence[NMEA_MAX_SENTENCE_ID] = {
      0}; ///< the next three letters of the most recent successfully parsed
          ///< sentence, e.g. GLL, RMC

  uint8_t hour;          ///< GMT hours
  uint8_t minute;        ///< GMT minutes
  uint8_t seconds;       ///< GMT seconds
  uint16_t milliseconds; ///< GMT milliseconds
  uint8_t year;          ///< GMT year
  uint8_t month;         ///< GMT month
  uint8_t day;           ///< GMT day

  nmea_float_t latitude;  ///< Floating point latitude value in degrees/minutes
                          ///< as received from the GPS (DDMM.MMMM)
  nmea_float_t longitude; ///< Floating point longitude value in degrees/minutes
                          ///< as received from the GPS (DDDMM.MMMM)

  /** Fixed point latitude and longitude value with degrees stored in units of
    1/10000000 of a degree. See pull #13 for more details:
    https://github.com/adafruit/Adafruit-GPS-Library/pull/13 */
  int32_t latitude_fixed;  ///< Fixed point latitude in decimal degrees.
                           ///< Divide by 10000000.0 to get a double.
  int32_t longitude_fixed; ///< Fixed point longitude in decimal degrees
                           ///< Divide by 10000000.0 to get a double.

  nmea_float_t latitudeDegrees;  ///< Latitude in decimal degrees
  nmea_float_t longitudeDegrees; ///< Longitude in decimal degrees
  nmea_float_t geoidheight;      ///< Diff between geoid height and WGS84 height
  nmea_float_t altitude;         ///< Altitude in meters above MSL
  nmea_float_t speed;            ///< Current speed over ground in knots
  nmea_float_t angle;            ///< Course in degrees from true north
  nmea_float_t magvariation; ///< Magnetic variation in degrees (vs. true north)
  nmea_float_t HDOP; ///< Horizontal Dilution of Precision - relative accuracy
                     ///< of horizontal position
  nmea_float_t VDOP; ///< Vertical Dilution of Precision - relative accuracy
                     ///< of vertical position
  nmea_float_t PDOP; ///< Position Dilution of Precision - Complex maths derives
                     ///< a simple, single number for each kind of DOP
  char lat = 'X';    ///< N/S
  char lon = 'X';    ///< E/W
  char mag = 'X';    ///< Magnetic variation direction
  bool fix;          ///< Have a fix?
  uint8_t fixquality;    ///< Fix quality (0, 1, 2 = Invalid, GPS, DGPS)
  uint8_t fixquality_3d; ///< 3D fix quality (1, 3, 3 = Nofix, 2D fix, 3D fix)
  uint8_t satellites;    ///< Number of satellites in use

  uint16_t LOCUS_serial;  ///< Log serial number
  uint16_t LOCUS_records; ///< Log number of data record
  uint8_t LOCUS_type;     ///< Log type, 0: Overlap, 1: FullStop
  uint8_t LOCUS_mode;     ///< Logging mode, 0x08 interval logger
  uint8_t LOCUS_config;   ///< Contents of configuration
  uint8_t LOCUS_interval; ///< Interval setting
  uint8_t LOCUS_distance; ///< Distance setting
  uint8_t LOCUS_speed;    ///< Speed setting
  uint8_t LOCUS_status;   ///< 0: Logging, 1: Stop logging
  uint8_t LOCUS_percent;  ///< Log life used percentage

}

void sendCommand(const struct device *uart_dev, uint8_t *cmd);
void playTrack(const struct device *uart_dev, char *track);
char read(void);

#endif /* _ADAFRUIT_GPS_H */
```

## src/audio_soundboard.h
```c
#ifndef _SOUNDBOARD_H_
#define _SOUNDBOARD_H_

#include <inttypes.h>
#include <device.h>
#include <drivers/uart.h>/*UART*/

void sendCommand(const struct device *uart_dev, uint8_t *cmd);
void playTrack(const struct device *uart_dev, char *track);

#endif /* _SOUNDBOARD_H_ */
```

## src/audio_soundboard_functions.c
```c
#include "audio_soundboard.h"
#include <string.h>
#include "config.h"

void sendCommand(const struct device *uart_dev, uint8_t *cmd)//Send Any command over UART
{
	int ret = uart_tx(uart_dev, cmd, COMMAND_SIZE, 100);
	if (ret) {
		printk("Error unable to send command (%d)\n", ret);
	}
};

void playTrack(const struct device *uart_dev, char *track)//Send Track over UART
{
	char text[13];
	strcpy(text, track);
	// printk("%s\n", text);
	// printk("%s\n", track);
	// printk("Size (%d)\n", sizeof(text), text);
	int ret = uart_tx(uart_dev, track, 13, 100);
	if (ret) {
		printk("Error unable to send command (%d)\n", ret);
	}
};
```

## src/config.h
```c
#ifndef _CONFIG_H_
#define _CONFIG_H_

/* Parameters */
#define UART_BAUDRATE 9600
#define UART_LABEL "UART_1"
#define UART_AUDIO "UART_2"
#define COMMAND_SIZE 2
#define TRACK_SIZE 13

#define SLEEP_TIME_MS 1
/* size of stack area used by each thread */
#define STACKSIZE 2048
/* scheduling priority used by each thread */
#define PRIORITY 7
//TIME BUTTON
#define SW0_NODE DT_ALIAS(sw0)
#define SW0_GPIO_LABEL DT_GPIO_LABEL(SW0_NODE, gpios)
#define SW0_GPIO_PIN DT_GPIO_PIN(SW0_NODE, gpios)
#define SW0_GPIO_FLAGS (GPIO_INPUT | DT_GPIO_FLAGS(SW0_NODE, gpios))
//SPEED BUTTON
#define SW1_NODE DT_ALIAS(sw1)
#define SW1_GPIO_LABEL DT_GPIO_LABEL(SW1_NODE, gpios)
#define SW1_GPIO_PIN DT_GPIO_PIN(SW1_NODE, gpios)
#define SW1_GPIO_FLAGS (GPIO_INPUT | DT_GPIO_FLAGS(SW1_NODE, gpios))
//UV BUTTON
#define SW2_NODE DT_ALIAS(sw2)
#define SW2_GPIO_LABEL DT_GPIO_LABEL(SW2_NODE, gpios)
#define SW2_GPIO_PIN DT_GPIO_PIN(SW2_NODE, gpios)
#define SW2_GPIO_FLAGS (GPIO_INPUT | DT_GPIO_FLAGS(SW2_NODE, gpios))

#endif /* _CONFIG_H_ */
```

## src/minmea.c
```c
// https://github.com/kosma/minmea
/*
 * Copyright © 2014 Kosma Moczek <kosma@cloudyourcar.com>
 * This program is free software. It comes without any warranty, to the extent
 * permitted by applicable law. You can redistribute it and/or modify it under
 * the terms of the Do What The Fuck You Want To Public License, Version 2, as
 * published by Sam Hocevar. See the COPYING file for more details.
 */

#include "minmea.h"

#include <stdlib.h>
#include <string.h>
#include <ctype.h>
#include <stdarg.h>
#include <time.h>

#define boolstr(s) ((s) ? "true" : "false")

static int hex2int(char c)
{
	if (c >= '0' && c <= '9')
		return c - '0';
	if (c >= 'A' && c <= 'F')
		return c - 'A' + 10;
	if (c >= 'a' && c <= 'f')
		return c - 'a' + 10;
	return -1;
}

uint8_t minmea_checksum(const char *sentence)
{
	// Support senteces with or without the starting dollar sign.
	if (*sentence == '$')
		sentence++;

	uint8_t checksum = 0x00;

	// The optional checksum is an XOR of all bytes between "$" and "*".
	while (*sentence && *sentence != '*')
		checksum ^= *sentence++;

	return checksum;
}

bool minmea_check(const char *sentence, bool strict)
{
	uint8_t checksum = 0x00;

	// Sequence length is limited.
	if (strlen(sentence) > MINMEA_MAX_LENGTH + 3)
		return false;

	// A valid sentence starts with "$".
	if (*sentence++ != '$')
		return false;

	// The optional checksum is an XOR of all bytes between "$" and "*".
	while (*sentence && *sentence != '*' &&
	       isprint((unsigned char)*sentence))
		checksum ^= *sentence++;

	// If checksum is present...
	if (*sentence == '*') {
		// Extract checksum.
		sentence++;
		int upper = hex2int(*sentence++);
		if (upper == -1)
			return false;
		int lower = hex2int(*sentence++);
		if (lower == -1)
			return false;
		int expected = upper << 4 | lower;

		// Check for checksum mismatch.
		if (checksum != expected)
			return false;
	} else if (strict) {
		// Discard non-checksummed frames in strict mode.
		return false;
	}

	// The only stuff allowed at this point is a newline.
	if (*sentence && strcmp(sentence, "\n") && strcmp(sentence, "\r\n"))
		return false;

	return true;
}

static inline bool minmea_isfield(char c)
{
	return isprint((unsigned char)c) && c != ',' && c != '*';
}

bool minmea_scan(const char *sentence, const char *format, ...)
{
	bool result = false;
	bool optional = false;
	va_list ap;
	va_start(ap, format);

	const char *field = sentence;
#define next_field()                                                           \
	do {                                                                   \
		/* Progress to the next field. */                              \
		while (minmea_isfield(*sentence))                              \
			sentence++;                                            \
		/* Make sure there is a field there. */                        \
		if (*sentence == ',') {                                        \
			sentence++;                                            \
			field = sentence;                                      \
		} else {                                                       \
			field = NULL;                                          \
		}                                                              \
	} while (0)

	while (*format) {
		char type = *format++;

		if (type == ';') {
			// All further fields are optional.
			optional = true;
			continue;
		}

		if (!field && !optional) {
			// Field requested but we ran out if input. Bail out.
			goto parse_error;
		}

		switch (type) {
		case 'c': { // Single character field (char).
			char value = '\0';

			if (field && minmea_isfield(*field))
				value = *field;

			*va_arg(ap, char *) = value;
		} break;

		case 'd': { // Single character direction field (int).
			int value = 0;

			if (field && minmea_isfield(*field)) {
				switch (*field) {
				case 'N':
				case 'E':
					value = 1;
					break;
				case 'S':
				case 'W':
					value = -1;
					break;
				default:
					goto parse_error;
				}
			}

			*va_arg(ap, int *) = value;
		} break;

		case 'f': { // Fractional value with scale (struct minmea_float).
			int sign = 0;
			int_least32_t value = -1;
			int_least32_t scale = 0;

			if (field) {
				while (minmea_isfield(*field)) {
					if (*field == '+' && !sign &&
					    value == -1) {
						sign = 1;
					} else if (*field == '-' && !sign &&
						   value == -1) {
						sign = -1;
					} else if (isdigit((
							   unsigned char)*field)) {
						int digit = *field - '0';
						if (value == -1)
							value = 0;
						if (value >
						    (INT32_MAX - digit) / 10) {
							/* we ran out of bits, what do we do? */
							if (scale) {
								/* truncate extra precision */
								break;
							} else {
								/* integer overflow. bail out. */
								goto parse_error;
							}
						}
						value = (10 * value) + digit;
						if (scale)
							scale *= 10;
					} else if (*field == '.' &&
						   scale == 0) {
						scale = 1;
					} else if (*field == ' ') {
						/* Allow spaces at the start of the field. Not NMEA
                             * conformant, but some modules do this. */
						if (sign != 0 || value != -1 ||
						    scale != 0)
							goto parse_error;
					} else {
						goto parse_error;
					}
					field++;
				}
			}

			if ((sign || scale) && value == -1)
				goto parse_error;

			if (value == -1) {
				/* No digits were scanned. */
				value = 0;
				scale = 0;
			} else if (scale == 0) {
				/* No decimal point. */
				scale = 1;
			}
			if (sign)
				value *= sign;

			*va_arg(ap, struct minmea_float *) =
				(struct minmea_float){ value, scale };
		} break;

		case 'i': { // Integer value, default 0 (int).
			int value = 0;

			if (field) {
				char *endptr;
				value = strtol(field, &endptr, 10);
				if (minmea_isfield(*endptr))
					goto parse_error;
			}

			*va_arg(ap, int *) = value;
		} break;

		case 's': { // String value (char *).
			char *buf = va_arg(ap, char *);

			if (field) {
				while (minmea_isfield(*field))
					*buf++ = *field++;
			}

			*buf = '\0';
		} break;

		case 't': { // NMEA talker+sentence identifier (char *).
			// This field is always mandatory.
			if (!field)
				goto parse_error;

			if (field[0] != '$')
				goto parse_error;
			for (int f = 0; f < 5; f++)
				if (!minmea_isfield(field[1 + f]))
					goto parse_error;

			char *buf = va_arg(ap, char *);
			memcpy(buf, field + 1, 5);
			buf[5] = '\0';
		} break;

		case 'D': { // Date (int, int, int), -1 if empty.
			struct minmea_date *date =
				va_arg(ap, struct minmea_date *);

			int d = -1, m = -1, y = -1;

			if (field && minmea_isfield(*field)) {
				// Always six digits.
				for (int f = 0; f < 6; f++)
					if (!isdigit((unsigned char)field[f]))
						goto parse_error;

				char dArr[] = { field[0], field[1], '\0' };
				char mArr[] = { field[2], field[3], '\0' };
				char yArr[] = { field[4], field[5], '\0' };
				d = strtol(dArr, NULL, 10);
				m = strtol(mArr, NULL, 10);
				y = strtol(yArr, NULL, 10);
			}

			date->day = d;
			date->month = m;
			date->year = y;
		} break;

		case 'T': { // Time (int, int, int, int), -1 if empty.
			struct minmea_time *time_ =
				va_arg(ap, struct minmea_time *);

			int h = -1, i = -1, s = -1, u = -1;

			if (field && minmea_isfield(*field)) {
				// Minimum required: integer time.
				for (int f = 0; f < 6; f++)
					if (!isdigit((unsigned char)field[f]))
						goto parse_error;

				char hArr[] = { field[0], field[1], '\0' };
				char iArr[] = { field[2], field[3], '\0' };
				char sArr[] = { field[4], field[5], '\0' };
				h = strtol(hArr, NULL, 10);
				i = strtol(iArr, NULL, 10);
				s = strtol(sArr, NULL, 10);
				field += 6;

				// Extra: fractional time. Saved as microseconds.
				if (*field++ == '.') {
					uint32_t value = 0;
					uint32_t scale = 1000000LU;
					while (isdigit((unsigned char)*field) &&
					       scale > 1) {
						value = (value * 10) +
							(*field++ - '0');
						scale /= 10;
					}
					u = value * scale;
				} else {
					u = 0;
				}
			}

			time_->hours = h;
			time_->minutes = i;
			time_->seconds = s;
			time_->microseconds = u;
		} break;

		case '_': { // Ignore the field.
		} break;

		default: { // Unknown.
			goto parse_error;
		}
		}

		next_field();
	}

	result = true;

parse_error:
	va_end(ap);
	return result;
}

bool minmea_talker_id(char talker[3], const char *sentence)
{
	char type[6];
	if (!minmea_scan(sentence, "t", type))
		return false;

	talker[0] = type[0];
	talker[1] = type[1];
	talker[2] = '\0';

	return true;
}

enum minmea_sentence_id minmea_sentence_id(const char *sentence, bool strict)
{
	if (!minmea_check(sentence, strict))
		return MINMEA_INVALID;

	char type[6];
	if (!minmea_scan(sentence, "t", type))
		return MINMEA_INVALID;

	if (!strcmp(type + 2, "RMC"))
		return MINMEA_SENTENCE_RMC;
	if (!strcmp(type + 2, "GGA"))
		return MINMEA_SENTENCE_GGA;
	if (!strcmp(type + 2, "GSA"))
		return MINMEA_SENTENCE_GSA;
	if (!strcmp(type + 2, "GLL"))
		return MINMEA_SENTENCE_GLL;
	if (!strcmp(type + 2, "GST"))
		return MINMEA_SENTENCE_GST;
	if (!strcmp(type + 2, "GSV"))
		return MINMEA_SENTENCE_GSV;
	if (!strcmp(type + 2, "VTG"))
		return MINMEA_SENTENCE_VTG;
	if (!strcmp(type + 2, "ZDA"))
		return MINMEA_SENTENCE_ZDA;

	return MINMEA_UNKNOWN;
}

bool minmea_parse_rmc(struct minmea_sentence_rmc *frame, const char *sentence)
{
	// $GPRMC,081836,A,3751.65,S,14507.36,E,000.0,360.0,130998,011.3,E*62
	char type[6];
	char validity;
	int latitude_direction;
	int longitude_direction;
	int variation_direction;
	if (!minmea_scan(sentence, "tTcfdfdffDfd", type, &frame->time,
			 &validity, &frame->latitude, &latitude_direction,
			 &frame->longitude, &longitude_direction, &frame->speed,
			 &frame->course, &frame->date, &frame->variation,
			 &variation_direction))
		return false;
	if (strcmp(type + 2, "RMC"))
		return false;

	frame->valid = (validity == 'A');
	frame->latitude.value *= latitude_direction;
	frame->longitude.value *= longitude_direction;
	frame->variation.value *= variation_direction;

	return true;
}

bool minmea_parse_gga(struct minmea_sentence_gga *frame, const char *sentence)
{
	// $GPGGA,123519,4807.038,N,01131.000,E,1,08,0.9,545.4,M,46.9,M,,*47
	char type[6];
	int latitude_direction;
	int longitude_direction;

	if (!minmea_scan(sentence, "tTfdfdiiffcfcf_", type, &frame->time,
			 &frame->latitude, &latitude_direction,
			 &frame->longitude, &longitude_direction,
			 &frame->fix_quality, &frame->satellites_tracked,
			 &frame->hdop, &frame->altitude, &frame->altitude_units,
			 &frame->height, &frame->height_units,
			 &frame->dgps_age))
		return false;
	if (strcmp(type + 2, "GGA"))
		return false;

	frame->latitude.value *= latitude_direction;
	frame->longitude.value *= longitude_direction;

	return true;
}

bool minmea_parse_gsa(struct minmea_sentence_gsa *frame, const char *sentence)
{
	// $GPGSA,A,3,04,05,,09,12,,,24,,,,,2.5,1.3,2.1*39
	char type[6];

	if (!minmea_scan(sentence, "tciiiiiiiiiiiiifff", type, &frame->mode,
			 &frame->fix_type, &frame->sats[0], &frame->sats[1],
			 &frame->sats[2], &frame->sats[3], &frame->sats[4],
			 &frame->sats[5], &frame->sats[6], &frame->sats[7],
			 &frame->sats[8], &frame->sats[9], &frame->sats[10],
			 &frame->sats[11], &frame->pdop, &frame->hdop,
			 &frame->vdop))
		return false;
	if (strcmp(type + 2, "GSA"))
		return false;

	return true;
}

bool minmea_parse_gll(struct minmea_sentence_gll *frame, const char *sentence)
{
	// $GPGLL,3723.2475,N,12158.3416,W,161229.487,A,A*41$;
	char type[6];
	int latitude_direction;
	int longitude_direction;

	if (!minmea_scan(sentence, "tfdfdTc;c", type, &frame->latitude,
			 &latitude_direction, &frame->longitude,
			 &longitude_direction, &frame->time, &frame->status,
			 &frame->mode))
		return false;
	if (strcmp(type + 2, "GLL"))
		return false;

	frame->latitude.value *= latitude_direction;
	frame->longitude.value *= longitude_direction;

	return true;
}

bool minmea_parse_gst(struct minmea_sentence_gst *frame, const char *sentence)
{
	// $GPGST,024603.00,3.2,6.6,4.7,47.3,5.8,5.6,22.0*58
	char type[6];

	if (!minmea_scan(sentence, "tTfffffff", type, &frame->time,
			 &frame->rms_deviation, &frame->semi_major_deviation,
			 &frame->semi_minor_deviation,
			 &frame->semi_major_orientation,
			 &frame->latitude_error_deviation,
			 &frame->longitude_error_deviation,
			 &frame->altitude_error_deviation))
		return false;
	if (strcmp(type + 2, "GST"))
		return false;

	return true;
}

bool minmea_parse_gsv(struct minmea_sentence_gsv *frame, const char *sentence)
{
	// $GPGSV,3,1,11,03,03,111,00,04,15,270,00,06,01,010,00,13,06,292,00*74
	// $GPGSV,3,3,11,22,42,067,42,24,14,311,43,27,05,244,00,,,,*4D
	// $GPGSV,4,2,11,08,51,203,30,09,45,215,28*75
	// $GPGSV,4,4,13,39,31,170,27*40
	// $GPGSV,4,4,13*7B
	char type[6];

	if (!minmea_scan(sentence, "tiii;iiiiiiiiiiiiiiii", type,
			 &frame->total_msgs, &frame->msg_nr, &frame->total_sats,
			 &frame->sats[0].nr, &frame->sats[0].elevation,
			 &frame->sats[0].azimuth, &frame->sats[0].snr,
			 &frame->sats[1].nr, &frame->sats[1].elevation,
			 &frame->sats[1].azimuth, &frame->sats[1].snr,
			 &frame->sats[2].nr, &frame->sats[2].elevation,
			 &frame->sats[2].azimuth, &frame->sats[2].snr,
			 &frame->sats[3].nr, &frame->sats[3].elevation,
			 &frame->sats[3].azimuth, &frame->sats[3].snr)) {
		return false;
	}
	if (strcmp(type + 2, "GSV"))
		return false;

	return true;
}

bool minmea_parse_vtg(struct minmea_sentence_vtg *frame, const char *sentence)
{
	// $GPVTG,054.7,T,034.4,M,005.5,N,010.2,K*48
	// $GPVTG,156.1,T,140.9,M,0.0,N,0.0,K*41
	// $GPVTG,096.5,T,083.5,M,0.0,N,0.0,K,D*22
	// $GPVTG,188.36,T,,M,0.820,N,1.519,K,A*3F
	char type[6];
	char c_true, c_magnetic, c_knots, c_kph, c_faa_mode;

	if (!minmea_scan(sentence, "tfcfcfcfc;c", type,
			 &frame->true_track_degrees, &c_true,
			 &frame->magnetic_track_degrees, &c_magnetic,
			 &frame->speed_knots, &c_knots, &frame->speed_kph,
			 &c_kph, &c_faa_mode))
		return false;
	if (strcmp(type + 2, "VTG"))
		return false;
	// check chars
	if (c_true != 'T' || c_magnetic != 'M' || c_knots != 'N' ||
	    c_kph != 'K')
		return false;
	frame->faa_mode = (enum minmea_faa_mode)c_faa_mode;

	return true;
}

bool minmea_parse_zda(struct minmea_sentence_zda *frame, const char *sentence)
{
	// $GPZDA,201530.00,04,07,2002,00,00*60
	char type[6];

	if (!minmea_scan(sentence, "tTiiiii", type, &frame->time,
			 &frame->date.day, &frame->date.month,
			 &frame->date.year, &frame->hour_offset,
			 &frame->minute_offset))
		return false;
	if (strcmp(type + 2, "ZDA"))
		return false;

	// check offsets
	if (abs(frame->hour_offset) > 13 || frame->minute_offset > 59 ||
	    frame->minute_offset < 0)
		return false;

	return true;
}

int minmea_gettime(struct timespec *ts, const struct minmea_date *date,
		   const struct minmea_time *time_)
{
	if (date->year == -1 || time_->hours == -1)
		return -1;

	struct tm tm;
	memset(&tm, 0, sizeof(tm));
	if (date->year < 80) {
		tm.tm_year = 2000 + date->year - 1900; // 2000-2079
	} else if (date->year >= 1900) {
		tm.tm_year = date->year - 1900; // 4 digit year, use directly
	} else {
		tm.tm_year = date->year; // 1980-1999
	}
	tm.tm_mon = date->month - 1;
	tm.tm_mday = date->day;
	tm.tm_hour = time_->hours;
	tm.tm_min = time_->minutes;
	tm.tm_sec = time_->seconds;

	time_t timestamp =
		timegm(&tm); /* See README.md if your system lacks timegm(). */
	if (timestamp != (time_t)-1) {
		ts->tv_sec = timestamp;
		ts->tv_nsec = time_->microseconds * 1000;
		return 0;
	} else {
		return -1;
	}
}

/* vim: set ts=4 sw=4 et: */
```

## src/uv_config.h
```c
// https://github.com/adafruit/Adafruit_SI1145_Library
#ifndef _UV_CONFIG_H
#define _UV_CONFIG_H

/* Parameters */
/* COMMANDS */
#define SI1145_PARAM_QUERY 0x80
#define SI1145_PARAM_SET 0xA0
#define SI1145_NOP 0x0
#define SI1145_RESET 0x01
#define SI1145_BUSADDR 0x02
#define SI1145_PS_FORCE 0x05
#define SI1145_ALS_FORCE 0x06
#define SI1145_PSALS_FORCE 0x07
#define SI1145_PS_PAUSE 0x09
#define SI1145_ALS_PAUSE 0x0A
#define SI1145_PSALS_PAUSE 0xB
#define SI1145_PS_AUTO 0x0D
#define SI1145_ALS_AUTO 0x0E
#define SI1145_PSALS_AUTO 0x0F
#define SI1145_GET_CAL 0x12

/* Parameters */
#define SI1145_PARAM_I2CADDR 0x00
#define SI1145_PARAM_CHLIST 0x01
#define SI1145_PARAM_CHLIST_ENUV 0x80
#define SI1145_PARAM_CHLIST_ENAUX 0x40
#define SI1145_PARAM_CHLIST_ENALSIR 0x20
#define SI1145_PARAM_CHLIST_ENALSVIS 0x10
#define SI1145_PARAM_CHLIST_ENPS1 0x01
#define SI1145_PARAM_CHLIST_ENPS2 0x02
#define SI1145_PARAM_CHLIST_ENPS3 0x04

#define SI1145_PARAM_PSLED12SEL 0x02
#define SI1145_PARAM_PSLED12SEL_PS2NONE 0x00
#define SI1145_PARAM_PSLED12SEL_PS2LED1 0x10
#define SI1145_PARAM_PSLED12SEL_PS2LED2 0x20
#define SI1145_PARAM_PSLED12SEL_PS2LED3 0x40
#define SI1145_PARAM_PSLED12SEL_PS1NONE 0x00
#define SI1145_PARAM_PSLED12SEL_PS1LED1 0x01
#define SI1145_PARAM_PSLED12SEL_PS1LED2 0x02
#define SI1145_PARAM_PSLED12SEL_PS1LED3 0x04

#define SI1145_PARAM_PSLED3SEL 0x03
#define SI1145_PARAM_PSENCODE 0x05
#define SI1145_PARAM_ALSENCODE 0x06

#define SI1145_PARAM_PS1ADCMUX 0x07
#define SI1145_PARAM_PS2ADCMUX 0x08
#define SI1145_PARAM_PS3ADCMUX 0x09
#define SI1145_PARAM_PSADCOUNTER 0x0A
#define SI1145_PARAM_PSADCGAIN 0x0B
#define SI1145_PARAM_PSADCMISC 0x0C
#define SI1145_PARAM_PSADCMISC_RANGE 0x20
#define SI1145_PARAM_PSADCMISC_PSMODE 0x04

#define SI1145_PARAM_ALSIRADCMUX 0x0E
#define SI1145_PARAM_AUXADCMUX 0x0F

#define SI1145_PARAM_ALSVISADCOUNTER 0x10
#define SI1145_PARAM_ALSVISADCGAIN 0x11
#define SI1145_PARAM_ALSVISADCMISC 0x12
#define SI1145_PARAM_ALSVISADCMISC_VISRANGE 0x20

#define SI1145_PARAM_ALSIRADCOUNTER 0x1D
#define SI1145_PARAM_ALSIRADCGAIN 0x1E
#define SI1145_PARAM_ALSIRADCMISC 0x1F
#define SI1145_PARAM_ALSIRADCMISC_RANGE 0x20

#define SI1145_PARAM_ADCCOUNTER_511CLK 0x70

#define SI1145_PARAM_ADCMUX_SMALLIR 0x00
#define SI1145_PARAM_ADCMUX_LARGEIR 0x03

/* REGISTERS */
#define SI1145_REG_PARTID 0x00
#define SI1145_REG_REVID 0x01
#define SI1145_REG_SEQID 0x02

#define SI1145_REG_INTCFG 0x03
#define SI1145_REG_INTCFG_INTOE 0x01
#define SI1145_REG_INTCFG_INTMODE 0x02

#define SI1145_REG_IRQEN 0x04
#define SI1145_REG_IRQEN_ALSEVERYSAMPLE 0x01
#define SI1145_REG_IRQEN_PS1EVERYSAMPLE 0x04
#define SI1145_REG_IRQEN_PS2EVERYSAMPLE 0x08
#define SI1145_REG_IRQEN_PS3EVERYSAMPLE 0x10

#define SI1145_REG_IRQMODE1 0x05
#define SI1145_REG_IRQMODE2 0x06

#define SI1145_REG_HWKEY 0x07
#define SI1145_REG_MEASRATE0 0x08
#define SI1145_REG_MEASRATE1 0x09
#define SI1145_REG_PSRATE 0x0A
#define SI1145_REG_PSLED21 0x0F
#define SI1145_REG_PSLED3 0x10
#define SI1145_REG_UCOEFF0 0x13
#define SI1145_REG_UCOEFF1 0x14
#define SI1145_REG_UCOEFF2 0x15
#define SI1145_REG_UCOEFF3 0x16
#define SI1145_REG_PARAMWR 0x17
#define SI1145_REG_COMMAND 0x18
#define SI1145_REG_RESPONSE 0x20
#define SI1145_REG_IRQSTAT 0x21
#define SI1145_REG_IRQSTAT_ALS 0x01

#define SI1145_REG_ALSVISDATA0 0x22
#define SI1145_REG_ALSVISDATA1 0x23
#define SI1145_REG_ALSIRDATA0 0x24
#define SI1145_REG_ALSIRDATA1 0x25
#define SI1145_REG_PS1DATA0 0x26
#define SI1145_REG_PS1DATA1 0x27
#define SI1145_REG_PS2DATA0 0x28
#define SI1145_REG_PS2DATA1 0x29
#define SI1145_REG_PS3DATA0 0x2A
#define SI1145_REG_PS3DATA1 0x2B
#define SI1145_REG_UVINDEX0 0x2C
#define SI1145_REG_UVINDEX1 0x2D
#define SI1145_REG_PARAMRD 0x2E
#define SI1145_REG_CHIPSTAT 0x30

#define SI1145_ADDR 0x60

#endif /* _UV_CONFIG_H */
```
